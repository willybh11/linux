// SPDX-License-Identifier: (GPL-2.0+ OR BSD-3-Clause)
/* Overlay for AD7779 
 *
 * Copyright 2022 Analog Devices Inc.
 */

/dts-v1/;
/plugin/;

&spidev0 {
	status = "disabled";
};

&spi0 {
	#address-cells = <1>;
	#size-cells = <0>;
	status = "okay";

	ad7779@0 {
		compatible = "adi,ad7779";
		reg = <0>;
		spi-max-frequency = <25000000>;
	};
};
