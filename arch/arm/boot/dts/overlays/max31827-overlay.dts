// SPDX-License-Identifier: (GPL-2.0+ OR BSD-3-Clause)
/* Overlay for MAX31827EVKIT
 *
 * Copyright 2023 Analog Devices Inc.
 */

/dts-v1/;
/plugin/;

/ {
	compatible = "bcrm, bcm2711";
};

&i2c_arm {
	#address-cells = <1>;
	#size-cells = <0>;
	status = "okay";

	max31827: max3127@42 {
		compatible = "max3127";
		reg = <0x42>;
	};
};
